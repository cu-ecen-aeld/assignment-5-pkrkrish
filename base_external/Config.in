## base_external/Config.in
```kconfig
menu "AESD customizations"
  source "../base_external/package/aesd-assignments/Config.in"
endmenu
menu "LDD customizations"
    source "../base_external/package/ldd/Config.in"
endmenu
```

## base_external/package/ldd/Config.in
```kconfig
config BR2_PACKAGE_LDD
    bool "ldd modules"
    depends on BR2_LINUX_KERNEL
    help
      Build misc-modules and scull from your ldd3 fork.
```
